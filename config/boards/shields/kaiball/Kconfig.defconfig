## config/west.yml
```yaml
manifest:
  remotes:
    - name: zmkfirmware
      url-base: https://github.com/petejohanson
    - name: pmwdriver
      url-base: https://github.com/kaiiiiiak
  projects:
    - name: zmk
      remote: zmkfirmware
      revision: feat/pointers-move-scroll
      import: app/west.yml
    - name: pmwdriver
      remote: pmwdriver
      revision: pmw3160
  self:
    path: config
```
